/*
 * Copyright (c) 2020 The ZMK Contributors
 *
 * SPDX-License-Identifier: MIT
 */

#include <dt-bindings/led/led.h>

&spi1 {
	compatible = "nordic,nrf-spim";
	/* Cannot be used together with i2c0. */
	status = "okay";
	mosi-pin = <38>;
	// Unused pins, needed for SPI definition, but not used by the ws2812 driver itself.
	sck-pin = <5>;
	miso-pin = <7>;
};
